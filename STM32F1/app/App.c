/*********************************************
	文件名：App.c
	功  能：CAS721H7 MODBUS-IO V1.0
	
	软件环境：uVersion(V5.12) + MDK-ARM(V5.12) + STM32F1标准外设库V3.4.0

	硬件环境:	CAS721  H7
	MCU:STM32F103C8(64K Flash 20k RAM)
	
	芯艺设计室(http://www.chipart.cn)  版权所有
	工程主页:http://www.chipart.cn/projects/prj_hit.asp?id=8
	
	历史记录
		佟长福 2017-10-13 创建
*********************************************/

#include "caframe.h"

/*
g_HolReg[0]:低6位对应开关输出
g_HolReg[1]:输出模拟量1
g_HolReg[2]:输出模拟量2
g_HolReg[3]:输入开关量
g_HolReg[4]:输入模拟量1
g_HolReg[5]:输入模拟量2
*/
uint16_t g_HolReg[6];  //MODBUS寄存器 
uint8_t g_mbBuf[256];    //通信用缓冲区
TIMER_TASK g_TestTask;

const uint8_t aucCRCHi[] = {
    0x00, 0xC1, 0x81, 0x40, 0x01, 0xC0, 0x80, 0x41, 0x01, 0xC0, 0x80, 0x41, 0x00, 0xC1, 0x81,
    0x40, 0x01, 0xC0, 0x80, 0x41, 0x00, 0xC1, 0x81, 0x40, 0x00, 0xC1, 0x81, 0x40, 0x01, 0xC0,
    0x80, 0x41, 0x01, 0xC0, 0x80, 0x41, 0x00, 0xC1, 0x81, 0x40, 0x00, 0xC1, 0x81, 0x40, 0x01,
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    0x00, 0xC1, 0x81, 0x40, 0x01, 0xC0, 0x80, 0x41, 0x01, 0xC0, 0x80, 0x41, 0x00, 0xC1, 0x81,
    0x40
};

const uint8_t aucCRCLo[] = {
    0x00, 0xC0, 0xC1, 0x01, 0xC3, 0x03, 0x02, 0xC2, 0xC6, 0x06, 0x07, 0xC7, 0x05, 0xC5, 0xC4,
    0x04, 0xCC, 0x0C, 0x0D, 0xCD, 0x0F, 0xCF, 0xCE, 0x0E, 0x0A, 0xCA, 0xCB, 0x0B, 0xC9, 0x09,
    0x08, 0xC8, 0xD8, 0x18, 0x19, 0xD9, 0x1B, 0xDB, 0xDA, 0x1A, 0x1E, 0xDE, 0xDF, 0x1F, 0xDD,
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    0x44, 0x84, 0x85, 0x45, 0x87, 0x47, 0x46, 0x86, 0x82, 0x42, 0x43, 0x83, 0x41, 0x81, 0x80,
    0x40
};
uint16_t mbCRC16(uint8_t * pucFrame, uint16_t usLen)
{
    uint8_t           ucCRCHi = 0xFF;
    uint8_t           ucCRCLo = 0xFF;
    int             iIndex;

    while( usLen-- )
    {
        iIndex = ucCRCLo ^ *( pucFrame++ );
        ucCRCLo = ucCRCHi ^ aucCRCHi[iIndex];
        ucCRCHi = aucCRCLo[iIndex];
    }
    return (((uint16_t)ucCRCLo) << 8) | ucCRCHi;
}

uint16_t BufToReg(uint8_t *buf)
{
  uint16_t ret=buf[0];
  ret<<=8;
  return ret+buf[1];
}

void RegToBuf(uint8_t *buf,uint16_t reg)
{
  buf[0]=reg>>8;
  buf[1]=reg;
}


//MODBUS 命令处理 函数
uint8_t mbCommand(uint8_t *buf,uint8_t len)
{
	uint8_t i,addr,size;
	uint16_t crc;
	
	if(buf[0]!=1)		//地址不符
		return 0;	
	
	if(mbCRC16(buf,len)) //校验
		return 0;	
		
	addr=BufToReg(buf+2);	
	size=BufToReg(buf+4);		
	if(buf[1]==0x03) 			//读多个寄存器
	{
		if(addr+size >6)  //无效地址和长度
			return 0;
		buf[2]=size*2; //数据长度
		len=3;
		for(i=0;i<size;i++)
		{
			RegToBuf(buf+len,g_HolReg[addr+i]);
			len+=2;
		}
		crc=mbCRC16(buf,len);
		RegToBuf(buf+len,crc);
		len+=2;
	}
	else if(buf[1]==0x10) //写多个寄存器
	{
		if(addr+size>3)		//数据地址和长度不符
			return 0;
		if(buf[6]!=size*2)	//写入长度不符
			return 0;
		for(i=0;i<size;i++)
			g_HolReg[addr+i]=BufToReg(buf+7+(i*2));
		crc=mbCRC16(buf,6);
		RegToBuf(buf+6,crc);
		len=8;
	}
	return len;
}

void Uart1Recv(void)
{
	uint8_t len;
	
	len=Uart1ReadRecv(g_mbBuf);
	/*if((len==6)&&(g_mbBuf[0]==0xAA))
	{
		if((g_mbBuf[1]=='B')&&(g_mbBuf[2]=='O')&&(g_mbBuf[3]=='O')&&(g_mbBuf[4]=='T')&&(g_mbBuf[5]==0x34))
			while(1); //等待看门狗复位
	}*/
	len=mbCommand(g_mbBuf,len);
//	DebugPrintBin(g_mbBuf,len);
	if(len>0)
		Uart1Send(g_mbBuf,len);
	
	LED_TOGGLE;
}

void Uart2Recv(void)
{
	uint8_t len;
	
	len=Uart2ReadRecv(g_mbBuf);
	len=mbCommand(g_mbBuf,len);
	if(len>0)
		Uart2Send(g_mbBuf,len);	
	LED_TOGGLE;
}

void Uart3Recv(void)
{
	uint8_t len;
	
	len=Uart3ReadRecv(g_mbBuf);
	len=mbCommand(g_mbBuf,len);
	if(len>0)
		Uart3Send(g_mbBuf,len);
	LED_TOGGLE;
}

//t0
void Timer0Event(void)
{
	uint8_t i,tmp;
	
	//LED_TOGGLE;
	
	tmp=(uint8_t)g_HolReg[0];
	for(i=0;i<8;i++)
	{
		if(tmp&0x01)
			drv_output(IO_Y1+i,1);
		else
			drv_output(IO_Y1+i,0);
		tmp>>=1;
		
		if(drv_input(IO_X1+i))
			g_HolReg[3]|=(1<<i);
		else
			g_HolReg[3]&=~(1<<i);
	}
	
	//drv_dac_output(IO_AO1,g_HolReg[1]);
	//drv_dac_output(IO_AO2,g_HolReg[2]);
	
	g_HolReg[4]=GetTemp(IO_AI1);
	g_HolReg[5]=GetTemp(IO_AI2);
}

//继电器测试任务
void TestTask(PTIMER_TASK pTask)
{
	TT_BEGIN(pTask); 

	drv_output(IO_Y1,0);
	TT_DELAY(pTask,2);
	
	drv_output(IO_Y1,1);
	drv_output(IO_Y2,0);
	TT_DELAY(pTask,2);
	
	drv_output(IO_Y1,0);
	drv_output(IO_Y2,1);
	drv_output(IO_Y3,0);
	TT_DELAY(pTask,2);
	
	drv_output(IO_Y2,0);
	drv_output(IO_Y3,1);
	drv_output(IO_Y4,0);
	TT_DELAY(pTask,2);
	
	drv_output(IO_Y3,0);
	drv_output(IO_Y4,1);
	drv_output(IO_Y5,0);
	TT_DELAY(pTask,2);
	
	drv_output(IO_Y4,0);
	drv_output(IO_Y5,1);
	drv_output(IO_Y6,0);
	TT_DELAY(pTask,2);
	
	drv_output(IO_Y5,0);
	drv_output(IO_Y6,1);
	TT_DELAY(pTask,2);
	
	drv_output(IO_Y6,0);
	
	TT_END(pTask);
}

void KeyEvent(uint16_t cnt)
{
	LED_TOGGLE;
	frm_begin_timer_task(&g_TestTask);
}

/*应用主程序初始化函数
在框架程序(frame.c)中调用的唯一应用接口函数
在这里要为框架程序安装所有需要的事件处理函数*/
void InitApp(void)
{
	frm_install_timer_event(0,500,Timer0Event);
	frm_bind_timer_task(0,&g_TestTask,TestTask);	//邦定关机任务
	
	frm_install_input_event(IO_X4,KeyEvent,5,ET_RISING_EDGE);	//按键处理
	
	frm_install_event(EVENT_UART1_ID,Uart1Recv);
	frm_install_event(EVENT_UART2_ID,Uart2Recv);
	frm_install_event(EVENT_UART3_ID,Uart3Recv);

}

int main(void)
{
	CAFrameInit();
	
	while(1)
	{
		CAFramePoll();
	}
	//return 0;
}


